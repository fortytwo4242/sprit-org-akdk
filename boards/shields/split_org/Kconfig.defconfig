## boards/shields/split_org/Kconfig.defconfig
```kconfig
if SHIELD_SPLIT_ORG_RIGHT

config ZMK_KEYBOARD_NAME
    default "split_org"

endif

if SHIELD_SPLIT_ORG_LEFT || SHIELD_SPLIT_ORG_RIGHT

config ZMK_SPLIT
    default y

endif
```

## boards/shields/split_org/Kconfig.shield
```kconfig
config SHIELD_SPLIT_ORG_LEFT
    def_bool $(shields_list_contains,split_org_left)
config SHIELD_SPLIT_ORG_RIGHT
    def_bool $(shields_list_contains,split_org_right)
```

## config/west.yml
```yaml
manifest:
  remotes:
    - name: zmkfirmware
      url-base: https://github.com/zmkfirmware
    - name: fortytwo4242
      url-base: https://github.com/fortytwo4242
  projects:
    - name: zmk
      remote: zmkfirmware
      revision: main
      import: app/west.yml
    - name: zmk-driver-paw3222
      remote: fortytwo4242
      revision: main
  self:
    path: config
```
